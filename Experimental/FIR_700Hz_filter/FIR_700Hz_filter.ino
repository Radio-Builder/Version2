#include <driver/i2s.h>
#include <math.h>
#include <freertos/FreeRTOS.h>
#include <freertos/task.h>


#include <driver/i2s.h>
#include <math.h>

#define NUM_TAPS 1024  // Number of filter taps
#define I2S_WS    33   // Word Select (LRCLK)
#define I2S_BCK   5    // Bit Clock (SCLK)
#define I2S_DOUT  25   // Serial Data Out (SDOUT)
#define I2S_DIN   26   // Serial Data In (SDIN)
#define I2S_MCLK   0   // Master Clock (MCLK) on GPIO 0


float apply_fir_filter(float input_sample);

// Define the I2S task function
void i2s_task(void *param) {
    // Create buffers for I2S read and write
    const int buffer_size = 512;
    char i2s_read_buffer[buffer_size];
    size_t bytes_read, bytes_written;

    while (1) {
        // Read data from I2S input (e.g., microphone or ADC)
        i2s_read(I2S_NUM_0, &i2s_read_buffer, buffer_size, &bytes_read, portMAX_DELAY);

        // Cast buffer to int16_t for 16-bit samples
        int16_t* samples = (int16_t*) i2s_read_buffer;
        int num_samples = bytes_read / sizeof(int16_t);  // Total number of samples

        // Apply the FIR filter to only the left channel (skip right channel samples)
        for (int i = 0; i < num_samples; i += 2) {  // Step by 2 to only process left channel
            float input = (float)samples[i];  // Process only the left channel sample

            // Apply the FIR filter
            float filtered_sample = apply_fir_filter(input);

            // Clipping to avoid overflow
            if (filtered_sample > 32767) {
                filtered_sample = 32767;
            } else if (filtered_sample < -32768) {
                filtered_sample = -32768;
            }

            // Set the processed left channel sample
            samples[i] = (int16_t)filtered_sample;

            // Optionally: Copy left channel sample to the right channel for symmetrical output
            samples[i + 1] = (int16_t)filtered_sample;  // Copy the same filtered left sample to right channel
        }

        // Write the filtered data back to I2S output (e.g., DAC or speaker)
        i2s_write(I2S_NUM_0, &i2s_read_buffer, bytes_read, &bytes_written, portMAX_DELAY);
    }

    vTaskDelete(NULL);  // Delete the task if it exits the loop
}

float fir_coefficients[NUM_TAPS] = {
    1.56048304e-05,     5.66541218e-05,     9.56158889e-05,     1.30958244e-04,     1.61282894e-04,     1.85379233e-04,     2.02271594e-04,     2.11257879e-04,     2.11938053e-04,     2.04231394e-04, 
    1.88381759e-04,     1.64950593e-04,     1.34797839e-04,     9.90513620e-05,     5.90659313e-05,     1.63732055e-05,     -2.73754974e-05,     -7.04715636e-05,     -1.11214292e-04,     -1.47976522e-04, 
    -1.79268206e-04,     -2.03795512e-04,     -2.20513149e-04,     -2.28667854e-04,     -2.27831269e-04,     -2.17920811e-04,     -1.99207558e-04,     -1.72310678e-04,     -1.38178373e-04,     -9.80558831e-05, 
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    1.30958244e-04,     9.56158889e-05,     5.66541218e-05,     1.56048304e-05, 
};


// Circular buffer for input samples
float input_buffer[NUM_TAPS] = {0};

// Function to apply the FIR filter
float apply_fir_filter(float input_sample) {
    // Shift the buffer (new sample comes in, old sample shifts out)
    for (int i = NUM_TAPS - 1; i > 0; i--) {
        input_buffer[i] = input_buffer[i - 1];
    }
    input_buffer[0] = input_sample;

    // Apply the FIR filter (convolution)
    float output_sample = 0;
    for (int i = 0; i < NUM_TAPS; i++) {
        output_sample += fir_coefficients[i] * input_buffer[i];
    }

    return output_sample;
}

void setup() {
    Serial.begin(115200);

    // I2S configuration for 22.05 kHz sample rate
    i2s_config_t i2s_config = {
        .mode = (i2s_mode_t)(I2S_MODE_MASTER | I2S_MODE_TX | I2S_MODE_RX),  // Master mode, TX and RX
        .sample_rate = 22050,  // Set the sample rate to 22.05 kHz
        .bits_per_sample = I2S_BITS_PER_SAMPLE_16BIT,  // 16-bit per sample
        .channel_format = I2S_CHANNEL_FMT_RIGHT_LEFT,  // Stereo
        .communication_format = I2S_COMM_FORMAT_I2S_MSB,  // I2S communication format
        .intr_alloc_flags = ESP_INTR_FLAG_LEVEL1,  // Interrupt level
        .dma_buf_count = 8,  // Number of DMA buffers
        .dma_buf_len = 64,  // DMA buffer length
        .use_apll = true,  // Use APLL for accurate MCLK
        .tx_desc_auto_clear = true,  // Auto clear TX descriptor
        .fixed_mclk = 0  // No fixed MCLK frequency
    };

    // Pin configuration (without MCLK)
    i2s_pin_config_t pin_config = {
        .bck_io_num = I2S_BCK,    // Bit Clock pin (SCLK)
        .ws_io_num = I2S_WS,      // Word Select pin (LRCLK)
        .data_out_num = I2S_DOUT, // Data Out pin (SDOUT)
        .data_in_num = I2S_DIN    // Data In pin (SDIN)
    };

    // Install and start I2S driver
    i2s_driver_install(I2S_NUM_0, &i2s_config, 0, NULL);
    i2s_set_pin(I2S_NUM_0, &pin_config);
    i2s_set_clk(I2S_NUM_0, 22050, I2S_BITS_PER_SAMPLE_16BIT, I2S_CHANNEL_STEREO);

    // Manually configure MCLK on GPIO 0 using APLL (Audio PLL)
    PIN_FUNC_SELECT(PERIPHS_IO_MUX_GPIO0_U, FUNC_GPIO0_CLK_OUT1);  // Set GPIO0 as CLK_OUT1
    WRITE_PERI_REG(PIN_CTRL, READ_PERI_REG(PIN_CTRL) & 0xFFFFFFF0);  // Set Clock Out Source

    Serial.println("I2S FIR Filter (128 Taps) Initialized with 22.05 kHz.");

        // Create the I2S processing task and pin it to a different core (e.g., core 0)
    xTaskCreatePinnedToCore(
        i2s_task,         // Task function
        "I2S Task",       // Name of the task (for debugging)
        2048,             // Stack size (in bytes)
        NULL,             // Task parameter (not used)
        1,                // Priority of the task
        NULL,             // Task handle (not used)
        0                 // Pin to core 0
    );
}

void loop() {
  // Print "Hello" to the Serial Monitor
    Serial.println("Hello");

    // Wait for 1 second (1000 milliseconds)
    delay(1000);
}

